## config/west.yml
```yaml
manifest:
  remotes:
    - name: zmkfirmware
      url-base: https://github.com/zmkfirmware
  projects:
    - name: zmk
      remote: zmkfirmware
      revision: 6690d535e6ae30946127b2f419ecca76c06b078f
      import: app/west.yml
  self:
    path: config
```
